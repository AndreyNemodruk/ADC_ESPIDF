## sdkconfig.defaults
```kconfig
CONFIG_ESPTOOLPY_FLASHSIZE_16MB=y
CONFIG_SPIRAM=y
CONFIG_SPIRAM_MODE_OCT=y
CONFIG_PARTITION_TABLE_CUSTOM=y
CONFIG_PARTITION_TABLE_CUSTOM_FILENAME="partitions.csv"
CONFIG_PARTITION_TABLE_FILENAME="partitions.csv"
CONFIG_ESP_DEFAULT_CPU_FREQ_MHZ_240=y
CONFIG_ESP_DEFAULT_CPU_FREQ_MHZ=240
CONFIG_I2S_ISR_IRAM_SAFE=y
CONFIG_I2S_CTRL_FUNC_IN_IRAM=y
CONFIG_I2C_INTERFACE=y
CONFIG_SSD1306_128x64=y
CONFIG_OFFSETX=0
CONFIG_I2C_PORT_0=y
CONFIG_RESET_GPIO=-1
```
